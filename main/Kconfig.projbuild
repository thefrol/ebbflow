## main/Kconfig.projbuild
```kconfig
menu "Ebbflow Lamp"

    config LAMP_DEVICE_NAME
        string "Имя устройства (hostname, будущий ID для обнаружения)"
        default "ebbflow-lamp-1"
        help
            Используется как hostname в сети. В будущем — основа для
            mDNS-имени и идентификатора устройства во флоте.

    config LAMP_WIFI_SSID
        string "Wi-Fi SSID"
        default "YOUR_SSID"

    config LAMP_WIFI_PASSWORD
        string "Wi-Fi пароль"
        default "YOUR_PASSWORD"

    config LAMP_GPIO
        int "GPIO лампы (выход на реле/драйвер)"
        default 8
        range 0 21

    config LAMP_ON_TIME
        string "Время включения (HH:MM, локальное)"
        default "06:00"

    config LAMP_OFF_TIME
        string "Время выключения (HH:MM, локальное)"
        default "23:00"
        help
            Если время выключения раньше времени включения — расписание
            считается идущим через полночь. Равные значения = свет всегда выключен.

    choice LAMP_MODE
        prompt "Режим выхода (дефолт первого запуска)"
        default LAMP_MODE_SCHEDULE
        help
            Только дефолт для первого запуска: дальше режим живёт в NVS
            и переключается через веб-интерфейс без перепрошивки.

        config LAMP_MODE_SCHEDULE
            bool "Расписание (свет): вкл/выкл по времени суток"
        config LAMP_MODE_PULSE
            bool "Импульсы (полив): короткие включения по таймеру"
    endchoice

    config LAMP_PULSE_INTERVAL_MIN
        int "Период импульсов, минуты (дефолт первого запуска)"
        default 180
        range 1 1440
        help
            Импульсы привязаны к полуночи: начало каждого интервала
            кратно этому числу минут от 00:00.

    config LAMP_PULSE_DURATION_SEC
        int "Длительность импульса, секунды (дефолт первого запуска)"
        default 15
        range 1 600
        help
            Должна быть меньше периода (LAMP_PULSE_INTERVAL_MIN * 60),
            иначе выход будет всегда выключен (защита в lamp_pulse_active).

    config LAMP_TIMEZONE
        string "Часовой пояс (POSIX TZ)"
        default "MSK-3"
        help
            POSIX-формат, знак смещения инвертирован: MSK-3 = UTC+3.
            Примеры: "MSK-3", "CET-1CEST,M3.5.0,M10.5.0/3".

    config LAMP_OTA_ENABLED
        bool "OTA-обновления с GitHub Releases"
        default y
        help
            Устройство периодически опрашивает последний релиз репозитория
            и при появлении новой версии обновляет прошивку по HTTPS
            (esp_https_ota, разметка с двумя OTA-слотами).

    config LAMP_OTA_REPO
        string "GitHub-репозиторий с релизами (owner/repo)"
        default "thefrol/ebbflow"
        depends on LAMP_OTA_ENABLED
        help
            Репозиторий должен быть публичным, иначе в запросах к API
            понадобится токен (не реализовано).

    config LAMP_OTA_CHECK_INTERVAL_MIN
        int "Интервал проверки обновлений (минуты)"
        default 60
        range 1 1440
        depends on LAMP_OTA_ENABLED
        help
            Анонимный GitHub API разрешает ~60 запросов в час с одного IP,
            поэтому чаще раза в 10 минут опрашивать бессмысленно.

    choice LAMP_DIAG_MODE
        prompt "Диагностический режим пина (для отладки железа)"
        default LAMP_DIAG_NORMAL
        help
            Режимы FORCE_OFF/BLINK игнорируют расписание и нужны только
            для проверки обвязки пина (MOSFET, реле). В боевой прошивке
            держать NORMAL.

        config LAMP_DIAG_NORMAL
            bool "Обычный (по расписанию)"
        config LAMP_DIAG_FORCE_OFF
            bool "Всегда выключено (пин жёстко в 0)"
        config LAMP_DIAG_BLINK
            bool "Мигание 1 Гц"
    endchoice

endmenu
```
